## firmware-build-espidf/sdkconfig.defaults
```kconfig
# Example ESP32-S3 sdkconfig for LVGL/MicroPython
CONFIG_ESP32S3=y
CONFIG_MICROPYTHON_LVGL=y
CONFIG_MICROPYTHON_ENABLE_MQTT=y
CONFIG_MICROPYTHON_ENABLE_ETHERNET=y
CONFIG_MICROPYTHON_ENABLE_I2C=y
CONFIG_MICROPYTHON_ENABLE_SPI=y

# Display and Touch example settings (tweak for your hardware)
CONFIG_MICROPYTHON_LVGL_DISPLAY_DRIVER=st7789
CONFIG_MICROPYTHON_LVGL_TOUCH_DRIVER=gt911

# Serial REPL
CONFIG_MICROPYTHON_PORT_USE_UART_REPL=y
CONFIG_MICROPYTHON_UART_REPL_BAUD=115200
```
